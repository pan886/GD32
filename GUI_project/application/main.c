
#include "gd32vf103.h"
#include "gd32vf103_timer.h"
#include "gd32vf103_gpio.h"
#include "gd32vf103_usart.h"

#include <stdio.h>
#include "gd32vf103_dac.h"
#include "gd32vf103_i2c.h"
#include "gd32vf103v_rvstar.h"
#include "n200_func.h"


#include "gd32vf103_bkp.h"
#include "gd32vf103_dma.h"

#include "gd32vf103.h"

#include "nuclei_sdk_soc.h"
#include "gd32vf103v_rvstar.h"
#include "gd32vf103.h"
#include "gd32vf103_exmc.h"

#include "gd32vf103_rcu.h"
#include "gui_28.h"
#include "gd32vf103.h"
#include "exmc_lcd.h"
#include "ili9320.h"
#include "picture.h"
#include "lcd.h"
#include "touch.h"
#include "ugui.h"
//#include "lvgl.h"
//#include "lv_conf.h"
u16 touch_x = 0;
u16 touch_y = 0;
u16 touch_x_T =0;
u16 touch_y_T =0;
uint16_t device_code;
char_format_struct char_format;

/*!
    \brief      main function
    \param[in]  none
    \param[out] none
    \retval     none
*/
#define gimage   1
#if gimage
const unsigned char gImage_qq[3200] = { /* 0X00,0X10,0X28,0X00,0X28,0X00,0X01,0X1B, */
0XFF,0XFF,0XFF,0XFF,0XFF,0XFF,0XFF,0XFF,0XFF,0XFF,0XFF,0XFF,0XFF,0XFF,0XFF,0XFF,
0XFF,0XFF,0XFF,0XFF,0XFF,0XFF,0XFF,0XFF,0XFF,0XFF,0XFF,0XFF,0XFF,0XFF,0XBE,0XF7,
0XFF,0XFF,0XDE,0XFF,0X38,0XC6,0X92,0X8C,0X8E,0X6B,0X6E,0X6B,0X10,0X7C,0X96,0XAD,
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0XE4,0XD2,0X6A,0XC3,0XB6,0XD5,0XFF,0XFF,0XFF,0XFF,0XFF,0XFF,0XFF,0XFF,0XFF,0XFF,
};
#endif
uint16_t readdata =0;
u16 ColorTab[]={RED,GREEN,BLUE,YELLOW};//定义颜色数组
u16 ColornTab[]={RED,MAGENTA,GREEN,BLUE,BLACK};
UG_GUI gui1;
int pen_state =0;
void gpio_config(void)
{
	 rcu_periph_clock_enable(RCU_GPIOA);
	 rcu_periph_clock_enable(RCU_GPIOB);
    /* SPI0 GPIO config:SCK/PA5, MISO/PA6, MOSI/PA7 */
    gpio_init(GPIOA, GPIO_MODE_OUT_PP, GPIO_OSPEED_10MHZ, GPIO_PIN_5 | GPIO_PIN_7);
    gpio_init(GPIOA, GPIO_MODE_IN_FLOATING, GPIO_OSPEED_10MHZ, GPIO_PIN_6);


    gpio_init(GPIOB, GPIO_MODE_OUT_PP, GPIO_OSPEED_10MHZ, GPIO_PIN_6);//PB10 CS


    gpio_init(GPIOB, GPIO_MODE_IN_FLOATING, GPIO_OSPEED_10MHZ, GPIO_PIN_8);//PEN PB8
}

//void lv_example_led_1(void)
//{
//    /*Create a LED and switch it OFF*/
//    lv_obj_t * led1  = lv_led_create(lv_scr_act());
//    lv_obj_align(led1, LV_ALIGN_CENTER, -80, 0);
//    lv_led_off(led1);
//
//    /*Copy the previous LED and set a brightness*/
//    lv_obj_t * led2  = lv_led_create(lv_scr_act());
//    lv_obj_align(led2, LV_ALIGN_CENTER, 0, 0);
//    lv_led_set_brightness(led2, 150);
//    lv_led_set_color(led2, lv_palette_main(LV_PALETTE_RED));
//
//    /*Copy the previous LED and switch it ON*/
//    lv_obj_t * led3  = lv_led_create(lv_scr_act());
//    lv_obj_align(led3, LV_ALIGN_CENTER, 80, 0);
//    lv_led_on(led3);
//}
void my_GUI_DrawPoint(UG_S16 x , UG_S16 y ,UG_COLOR c )
{
	GUI_DrawPoint(x,y,c);
}


void HW_DrawLine( UG_S16 x1 , UG_S16 y1 , UG_S16 x2 , UG_S16 y2 , UG_COLOR c )
{
	LCD_DrawLine(x1,  y1,  x2,  y2);
}


void HW_FillFrame( UG_S16 x1 , UG_S16 y1 , UG_S16 x2 , UG_S16 y2 , UG_COLOR c )
{
	LCD_DrawFillRectangle(x1,y1,x2,y2,c);
}
#define MAX_OBJECTS 10
UG_WINDOW window_1 ;
UG_WINDOW window_2 ;
UG_WINDOW window_3;
   UG_BUTTON button_1 ;
   UG_BUTTON button1_1;
   UG_BUTTON button1_2;
   UG_BUTTON button1_3;
   UG_BUTTON button1_4;
   UG_BUTTON button1_5;
   UG_BUTTON button1_6;
   UG_OBJECT obj_buff_wnd_1[10];
   UG_OBJECT obj_buff_wnd_2[10];
   UG_CHECKBOX checkbox1;
   UG_BUTTON button3_1;
   UG_TEXTBOX textbox3_1;
   UG_BUTTON button2_1;
   UG_TEXTBOX textbox2_1;
   UG_TEXTBOX textbox2_2;
   uint16_t tocuh_flag  =0;
   uint16_t touch_flag2 = 0;
   volatile UG_U32 hw_acc = 0;
   int abc =0;
   int abc2 =0;
   int abc3 =0;
   int abc4 =0;
   int abc5 =0;
   UG_OBJECT obj_buff_wnd_3[MAX_OBJECTS];

   void  window_2_callback(UG_MESSAGE* msg )
   {
	   if ( msg->type == MSG_TYPE_OBJECT )
	      {
	         if ( msg->id == OBJ_TYPE_BUTTON )
	         {

	        	 {

	        		 switch( msg->sub_id )
	        		 {
	        		 	 case BTN_ID_0:
	        		 	 {
	        		 		if(window_2.objlst[0].touch_state&OBJ_TOUCH_STATE_RELEASED_ON_OBJECT)
	        		 		{

	        		 			UG_WindowHide( &window_2 );
	        		 		window_2.objlst[0].touch_state = 16;
	        		 		window_1.objlst[4].touch_state = 16;
	        		 		}
	                     break;
	        		 	 }
	        		 }
	        	 }
	         }
	      }

   }
   void window_1_callback(UG_MESSAGE* msg )
   {

	   if( msg->type == MSG_TYPE_OBJECT )
	   {


		   {
		   if ( msg->id == OBJ_TYPE_BUTTON )
		   {
			   switch ( msg->sub_id )
			   {

			   	   case BTN_ID_0:
				   {
					   if(window_1.objlst[0].touch_state&OBJ_TOUCH_STATE_RELEASED_ON_OBJECT)
					   gd_rvstar_led_toggle(LED1);
					   break;
				   }

			   	   case BTN_ID_1:
				   {
					   if(window_1.objlst[1].touch_state&OBJ_TOUCH_STATE_RELEASED_ON_OBJECT)
					   gd_rvstar_led_toggle(LED2);
					   break;
				   }
			   	   case BTN_ID_2:
				   {
					   if(window_1.objlst[2].touch_state&OBJ_TOUCH_STATE_RELEASED_ON_OBJECT)
					   gd_rvstar_led_toggle(LED3);


					   break;
				   }
			   	   case BTN_ID_3:
				   {
					   if(window_1.objlst[3].touch_state&OBJ_TOUCH_STATE_RELEASED_ON_OBJECT)
					   {

						   gd_rvstar_led_toggle(LED3);
							 if ( hw_acc )
						    	{
						    						   		UG_ButtonSetForeColor( &window_1, 4, C_RED );
						    						   		UG_ButtonSetText( &window_1, 4, "OFF" );
						    						   		UG_DriverEnable( DRIVER_DRAW_LINE );
						    						   		UG_DriverEnable( DRIVER_FILL_FRAME );
						    	}
						    	else
						    	{
						    						   		UG_ButtonSetForeColor( &window_1, 4, C_BLUE );
						    						   		UG_ButtonSetText( &window_1, 4, "ON" );
						    						   		UG_DriverDisable( DRIVER_DRAW_LINE );
						    						   		UG_DriverDisable( DRIVER_FILL_FRAME );
						    	}

							 hw_acc = !hw_acc;
					   }

					   break;
				   }

			   	 case BTN_ID_4: /* Resize window */
			   			{
			   				 if(window_1.objlst[4].touch_state&OBJ_TOUCH_STATE_RELEASED_ON_OBJECT)

			   				   	 UG_WindowShow( &window_2 );
			   				   	 break;

			   		}
			   	 case BTN_ID_5: /* Resize window */
			   	            {
			   	            	if(window_1.objlst[5].touch_state&OBJ_TOUCH_STATE_RELEASED_ON_OBJECT)

			   	            		UG_WindowShow( &window_3 );
			   	             break;

			   	            }
			   }
		   }
		   }
	   }
   }
   /* Callback function for the result window */
   void window_3_callback( UG_MESSAGE* msg )
   {
      if ( msg->type == MSG_TYPE_OBJECT )
      {
         if ( msg->id == OBJ_TYPE_BUTTON )
         {
            switch( msg->sub_id )
            {
               /* OK button */
               case BTN_ID_0:
               {
            	   if(window_3.objlst[1].touch_state&OBJ_TOUCH_STATE_RELEASED_ON_OBJECT)
            	   {

            		   UG_WindowHide( &window_3 );

            		   window_3.objlst[1].touch_state = 16;
            		   window_1.objlst[5].touch_state = 16;

            	   }
                  break;
               }
            }
         }
      }
   }

int main(void)
{
    uint16_t i;

# if 1
	u16 j=0;
	u16 colorTemp=0;
   // rcu_ahb_clock_config(54);
    /* configure the EXMC access mode */
	gpio_config();
    exmc_lcd_init();
    delay_1ms(10);
    LCD_Init();

    gd_rvstar_led_init(LED1);
    gd_rvstar_led_init(LED2);
    gd_rvstar_led_init(LED3);
    gd_rvstar_led_off(LED1);
    gd_rvstar_led_off(LED2);
    gd_rvstar_led_off(LED3);
    eclic_global_interrupt_enable();
    eclic_set_nlbits(ECLIC_GROUP_LEVEL3_PRIO1);
    eclic_irq_enable(TIMER1_IRQn,1,0);
    timer_config();
    //LCD_DrawLine(30,50,30,160);
   // LCD_DrawLine(100,50,100,60);
//	Gui_Drawbmp16(30,90,gImage_qq);



    GUI_DrawPoint(10,10,0);
    UG_Init(&gui1, (void(*)(UG_S16,UG_S16,UG_COLOR))my_GUI_DrawPoint,240,320);
    UG_DriverRegister(DRIVER_DRAW_LINE, ( void *) HW_DrawLine ) ;
    UG_DriverRegister( DRIVER_FILL_FRAME, ( void *) HW_FillFrame ) ;
    UG_DriverEnable( DRIVER_DRAW_LINE ) ;
    UG_DriverEnable ( DRIVER_FILL_FRAME) ;
   // LCD_DrawFillRectangle(10,10,30,30,0);
#endif

    UG_WindowCreate( &window_1, obj_buff_wnd_1, 10, window_1_callback );

    UG_WindowSetTitleText( &window_1, "icore  RV STAR" );
    UG_WindowSetTitleTextColor( &window_1, C_BLACK);
    UG_WindowSetTitleTextFont( &window_1, &FONT_12X20);
    UG_ButtonCreate( &window_1, &button1_1, BTN_ID_0, 10, 10, 110, 60 );
    UG_ButtonCreate( &window_1, &button1_2, BTN_ID_1, 10, 80, 110, 130 );
    UG_ButtonCreate( &window_1, &button1_3, BTN_ID_2, 10, 150, 110,200 );
    UG_ButtonCreate( &window_1, &button1_4, BTN_ID_3, 120, 10, UG_WindowGetInnerWidth( &window_1 ) - 10 , 60 );
    UG_ButtonCreate( &window_1, &button1_5, BTN_ID_4, 120, 80, UG_WindowGetInnerWidth( &window_1 ) - 10, 130 );
    UG_ButtonCreate( &window_1, &button1_6, BTN_ID_5, 120, 150, UG_WindowGetInnerWidth( &window_1 ) - 10, 200 );
    UG_ButtonSetFont( &window_1, BTN_ID_0, &FONT_12X20 );
    UG_ButtonSetBackColor( &window_1, BTN_ID_0, C_FOREST_GREEN );
    UG_ButtonSetText( &window_1, BTN_ID_0, "GREEN" );
    	      /* Configure Button 2 */
    UG_ButtonSetFont( &window_1, BTN_ID_1, &FONT_12X20 );
    UG_ButtonSetBackColor( &window_1, BTN_ID_1, C_BLUE );
    UG_ButtonSetText( &window_1, BTN_ID_1, "BLUE" );
    	      /* Configure Button 3 */
    UG_ButtonSetFont( &window_1, BTN_ID_2, &FONT_16X26 );
    UG_ButtonSetText( &window_1, BTN_ID_2, "RED" );
    UG_ButtonSetBackColor( &window_1, BTN_ID_2, C_RED );


    	      /* Configure Button 4 */
    UG_ButtonSetFont( &window_1, BTN_ID_3, &FONT_16X26 );
    UG_ButtonSetForeColor( &window_1, BTN_ID_3, C_RED );
    UG_ButtonSetText( &window_1, BTN_ID_3, "OPEN" );
    	        /* Configure Button 5 */
    UG_ButtonSetFont( &window_1, BTN_ID_4, &FONT_12X20 );
    UG_ButtonSetText( &window_1, BTN_ID_4, "ABOUT" );
    	           /* Configure Button 6 */
    UG_ButtonSetFont( &window_1, BTN_ID_5, &FONT_16X26);
    UG_ButtonSetText( &window_1, BTN_ID_5, "FIRE!" );


    UG_WindowCreate( &window_2, obj_buff_wnd_2, MAX_OBJECTS, window_2_callback );
    UG_WindowSetTitleText( &window_2, "Info" );
    UG_WindowSetTitleTextFont( &window_2, &FONT_12X20 );
    // UG_WindowResize( &window_2, 20, 40, 219, 300 );

    	              /* Create Button 1 */
    UG_ButtonCreate( &window_2, &button2_1, BTN_ID_0, 60, 100, 180, 150 );
    UG_ButtonSetFont( &window_2, BTN_ID_0, &FONT_12X20 );
    UG_ButtonSetText( &window_2, BTN_ID_0, "RETURN!" );

    	              /* Create Textbox 1 */
    UG_TextboxCreate( &window_2, &textbox2_1, TXB_ID_0, 10, 10, UG_WindowGetInnerWidth( &window_2 )-10, 40 );
    UG_TextboxSetFont( &window_2, TXB_ID_0, &FONT_16X26 );
    UG_TextboxSetText( &window_2, TXB_ID_0, "GUI v0.3" );
    UG_TextboxSetAlignment( &window_2, TXB_ID_0, ALIGN_TOP_CENTER );

    UG_WindowCreate( &window_3, obj_buff_wnd_3, MAX_OBJECTS, window_3_callback );
    UG_WindowSetTitleText( &window_3, "engine start" );
    UG_WindowSetTitleTextFont( &window_3, &FONT_10X16 );
   // UG_WindowResize( &window_3, 20, 60, 219, 300 );

    	            /* Create Textbox 1 */
    UG_TextboxCreate( &window_3, &textbox3_1, TXB_ID_0, 5, 25, 220, 120 );
    UG_TextboxSetFont( &window_3, TXB_ID_0, &FONT_16X26);
    UG_TextboxSetText( &window_3, TXB_ID_0, "cannot start:\n because of \n no key!");
    UG_TextboxSetAlignment( &window_3, TXB_ID_0, ALIGN_TOP_LEFT );

    	            /* Create Button 1 */
    UG_ButtonCreate( &window_3, &button3_1, BTN_ID_0, 40, 125, 180, 210 );
    UG_ButtonSetFont( &window_3, BTN_ID_0, &FONT_32X53 );
    UG_ButtonSetText( &window_3, BTN_ID_0, "OK!" );

       UG_WindowShow( &window_1 );

    UG_TouchUpdate(-1,-1,TOUCH_STATE_RELEASED);	//触摸坐标更新

    while(1){

    	abc =window_1.objlst[0].touch_state;
    	abc4 =window_1.objlst[1].touch_state;
    	abc5 =window_1.objlst[3].touch_state;
    	abc2=window_1.objlst[5].touch_state;
    	abc3 =window_3.objlst[1].touch_state;


    	pen_state = gpio_input_bit_get(GPIOB,GPIO_PIN_8);
		if(gpio_input_bit_get(GPIOB,GPIO_PIN_8)==0)//有按键按下
    	{

			delay_1ms(10);
			if(gpio_input_bit_get(GPIOB,GPIO_PIN_8)==0)//有按键按下
			{
    	   	  TP_Read_XY2(&touch_x,&touch_y);
    	   	touch_x_T = (uint16_t)(touch_x*240/4095);
        	touch_y_T = (uint16_t)(touch_y*320/4095);
        	if((touch_x_T>0)&&(touch_x_T<239)&&((touch_y_T>0)&&(touch_y_T<319)))
        	{

    				{

    					//gd_rvstar_led_toggle(LED2);
    					UG_TouchUpdate(touch_x_T,touch_y_T,TOUCH_STATE_PRESSED);	//触摸坐标更新
    				}


        		}

    	}
    	}
        	else
    	    	{
    	    		   UG_TouchUpdate(-1,-1,TOUCH_STATE_RELEASED);	//触摸坐标更新
    	    	}



#if 0
    	  TP_Read_XY(&tp_dev.x,&tp_dev.y);//第一次读取初始化
    	    LCD_Clear(WHITE);//清屏
    	    TP_Adjust();


    	    		tp_dev.scan(0);
    	    		if(tp_dev.sta&TP_PRES_DOWN)			//触摸屏被按下
    	    		{
    	    		 	if(tp_dev.x<lcddev.width&&tp_dev.y<lcddev.height)
    	    			{
    	    				if(tp_dev.x>(lcddev.width-24)&&tp_dev.y<16)
    	    				{
    	    					//DrawTestPage("测试10:Touch(按KEY0校准)      ");//清除
    	    					LCD_ShowString(lcddev.width-24,0,16,"RST",1);//显示清屏区域
    	    					POINT_COLOR=colorTemp;
    	    					LCD_Fill(lcddev.width-50,2,lcddev.width-50+22,18,POINT_COLOR);
    	    				}
    	    				else if((tp_dev.x>(lcddev.width-50)&&tp_dev.x<(lcddev.width-50+22))&&tp_dev.y<20)
    	    				{
    	    				LCD_Fill(lcddev.width-50,2,lcddev.width-50+22,18,ColorTab[j%5]);
    	    				POINT_COLOR=ColorTab[(j++)%5];
    	    				colorTemp=POINT_COLOR;
    	    				delay_1ms(10);
    	    				}

    	    				else TP_Draw_Big_Point(tp_dev.x,tp_dev.y,POINT_COLOR);		//画图
    	    			}
    	    		}else delay_1ms(10);	//没有按键按下的时候

//    	    		{
//
//    	    			LCD_Clear(WHITE);//清屏
//    	    		    TP_Adjust();  //屏幕校准
//    	    			//TP_Save_Adjdata();
//    	    			//DrawTestPage("测试10:Touch(按KEY0校准)      ");
//    	    			LCD_ShowString(lcddev.width-24,0,16,"RST",1);//显示清屏区域
//    	    			POINT_COLOR=colorTemp;
//    	    			LCD_Fill(lcddev.width-50,2,lcddev.width-50+22,18,POINT_COLOR);
//    	    		}
    	    		i++;
    	    		if(i==30)
    	    		{
    	    			i=0;

    	    			//break;
    	    		}
#endif
    	    		// UG_Update() ;

    	    		  //Gui_Drawbmp16(100,230,gImage_qq);

    	    		//lv_task_handler();
    }
}

/**
    \brief      configure the TIMER peripheral
    \param[in]  none
    \param[out] none
    \retval     none
  */
void timer_config(void)
{
    /* ----------------------------------------------------------------------------
    TIMER1 Configuration:
    TIMER1CLK = SystemCoreClock/5400 = 20KHz.
    TIMER1 configuration is timing mode, and the timing is 0.2s(4000/20000 = 0.2s).
    CH0 update rate = TIMER1 counter clock/CH0CV = 20000/4000 = 5Hz.
    ---------------------------------------------------------------------------- */
    timer_oc_parameter_struct timer_ocinitpara;
    timer_parameter_struct timer_initpara;

    rcu_periph_clock_enable(RCU_TIMER1);

    timer_deinit(TIMER1);
    /* initialize TIMER init parameter struct */
    timer_struct_para_init(&timer_initpara);
    /* TIMER1 configuration */
    timer_initpara.prescaler         = 5399;
    timer_initpara.alignedmode       = TIMER_COUNTER_EDGE;
    timer_initpara.counterdirection  = TIMER_COUNTER_UP;
    timer_initpara.period            = 2000;
    timer_initpara.clockdivision     = TIMER_CKDIV_DIV2;
    timer_init(TIMER1, &timer_initpara);
#if 1
    /* initialize TIMER channel output parameter struct */
    timer_channel_output_struct_para_init(&timer_ocinitpara);
    /* CH0,CH1 and CH2 configuration in OC timing mode */
    timer_ocinitpara.outputstate  = TIMER_CCX_ENABLE;
    timer_ocinitpara.ocpolarity   = TIMER_OC_POLARITY_HIGH;
    timer_ocinitpara.ocidlestate  = TIMER_OC_IDLE_STATE_LOW;
    timer_channel_output_config(TIMER1, TIMER_CH_0, &timer_ocinitpara);

    /* CH0 configuration in OC timing mode */
    timer_channel_output_pulse_value_config(TIMER1, TIMER_CH_0, 2000);
    timer_channel_output_mode_config(TIMER1, TIMER_CH_0, TIMER_OC_MODE_TIMING);
    timer_channel_output_shadow_config(TIMER1, TIMER_CH_0, TIMER_OC_SHADOW_DISABLE);
#endif
    timer_interrupt_enable(TIMER1, TIMER_INT_CH0);
    timer_enable(TIMER1);
}

/**
  * @brief  This function handles TIMER1 interrupt request.
  * @param  None
  * @retval None
  */
void TIMER1_IRQHandler(void)
{
    if(SET == timer_interrupt_flag_get(TIMER1, TIMER_INT_CH0)){
        /* clear channel 0 interrupt bit */
        timer_interrupt_flag_clear(TIMER1, TIMER_INT_CH0);
        Gui_StrCenter(50,36,BLACK,C_YELLOW,"中 微 爱 芯 潘 工",16,0);
        UG_Update() ; // lv_tick_inc(1);//lvgl 的 1ms 心跳

        //gd_rvstar_led_toggle(LED2);

    }
}
